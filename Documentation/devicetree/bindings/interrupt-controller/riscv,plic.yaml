## Documentation/devicetree/bindings/interrupt-controller/riscv,plic.yaml
```yaml
# SPDX-License-Identifier: (GPL-2.0-only OR BSD-2-Clause)
%YAML 1.2
---
$id: http://devicetree.org/schemas/interrupt-controller/riscv,plic.yaml#
$schema: http://devicetree.org/meta-schemas/core.yaml#

title: RISC-V Platform-Level Interrupt Controller (PLIC)

maintainers:
  - support@nucleisys.com

description: |
  RISC-V SOC includes an implementation of the Platform-Level Interrupt
  Controller (PLIC) as specified in the RISC-V Privileged Architecture
  specification. The PLIC connects all external interrupts in the system
  to all hart contexts in the system, via the external interrupt source
  in each hart.

  A hart context is a privilege mode in a hardware execution thread.
  For example, in an 4 core system with 2-way SMT, you have 8 harts
  and probably at least two privilege modes per hart; machine mode and
  supervisor mode.

  Each interrupt can be enabled on per-context basis. Any context can
  claim a pending enabled interrupt and then release it once it has
  been handled.

  Each interrupt has a configurable priority. Higher priority interrupts
  are serviced first. Each context can specify a priority threshold.
  Interrupts with priority below this threshold will not cause the PLIC
  to raise its interrupt line leading to the context.

allOf:
  - $ref: /schemas/interrupt-controller.yaml#

properties:
  compatible:
    oneOf:
      - items:
          - enum:
              - sifive,fu540-c000-plic
              - nuclei,ux600-plic
              - nuclei,ux600fd-plic
          - const: sifive,plic-1.0.0
      - const: riscv,plic0

  reg:
    maxItems: 1

  interrupts-extended:
    minItems: 1
    description: |
      Specifies which contexts are connected to the PLIC. Each node
      pointed to should be a riscv,cpu-intc node.

  riscv,ndev:
    $ref: /schemas/types.yaml#/definitions/uint32
    description: |
      Specifies how many external interrupts are supported by this
      controller.

  interrupt-controller: true

  "#interrupt-cells":
    const: 1

  "#address-cells":
    const: 0

required:
  - compatible
  - reg
  - interrupt-controller
  - "#interrupt-cells"
  - riscv,ndev
  - interrupts-extended

additionalProperties: false

examples:
  - |
    plic0: interrupt-controller@8000000 {
        compatible = "nuclei,ux600-plic", "sifive,plic-1.0.0";
        reg = <0x0 0x8000000 0x0 0x4000000>;
        interrupt-controller;
        #interrupt-cells = <1>;
        riscv,ndev = <53>;
        interrupts-extended = <&cpu0_intc 11 &cpu0_intc 9>;
    };

...
```

## Documentation/devicetree/bindings/net/fsl,fsl-mac.yaml
```yaml
# SPDX-License-Identifier: (GPL-2.0-only OR BSD-2-Clause)
%YAML 1.2
---
$id: http://devicetree.org/schemas/net/fsl,fsl-mac.yaml#
$schema: http://devicetree.org/meta-schemas/core.yaml#

title: Freescale FSL MAC Ethernet Controller

maintainers:
  - support@nucleisys.com

description: |
  FSL MAC Ethernet controller used in Nuclei UX600 series SoCs.
  This is a 10/100/1000 Mbps Ethernet MAC controller.

allOf:
  - $ref: ethernet-controller.yaml#

properties:
  compatible:
    oneOf:
      - const: fsl,fsl-mac
      - items:
          - enum:
              - nuclei,ux600-mac
              - nuclei,ux600fd-mac
          - const: fsl,fsl-mac

  reg:
    maxItems: 1

  interrupts:
    minItems: 1
    maxItems: 3
    description: |
      Interrupt specifications. May have up to 3 interrupts for
      TX, RX, and error conditions.

  interrupt-names:
    minItems: 1
    maxItems: 3

  clocks:
    maxItems: 1

  clock-names:
    items:
      - const: hfclk

  num-cs: true

  "#address-cells":
    const: 1

  "#size-cells":
    const: 0

required:
  - compatible
  - reg
  - interrupts
  - clocks

unevaluatedProperties: false

examples:
  - |
    mac: ethernet@67800000 {
        compatible = "nuclei,ux600fd-mac", "fsl,fsl-mac";
        reg = <0x0 0x67800000 0x0 0x1000>;
        interrupt-parent = <&plic0>;
        interrupts = <10>, <11>, <12>;
        clocks = <&hfclk>;
        num-cs = <1>;
        #address-cells = <1>;
        #size-cells = <0>;
        status = "okay";
    };

...
```

## Documentation/devicetree/bindings/riscv/nuclei.yaml
```yaml
# SPDX-License-Identifier: (GPL-2.0-only OR BSD-2-Clause)
%YAML 1.2
---
$id: http://devicetree.org/schemas/riscv/nuclei.yaml#
$schema: http://devicetree.org/meta-schemas/core.yaml#

title: Nuclei SoC-based boards

maintainers:
  - support@nucleisys.com

description: |
  Nuclei Technology SoC-based boards

  The Nuclei UX600 series is a RISC-V-based SoC family with the following
  features:
    - Single core RV64IMAC[FDC] CPU
    - Platform-Level Interrupt Controller (PLIC)
    - UART, SPI, GPIO, I2C peripherals
    - Ethernet controller
    - Watchdog timer

properties:
  $nodename:
    const: '/'

  compatible:
    oneOf:
      - items:
          - enum:
              - nuclei,ux600-sim
          - const: nuclei,ux600
      - items:
          - enum:
              - nuclei,ux600fd-sim
              - nuclei,ux600fd-entire
              - nuclei,ux600fd-ramfs-jffs2
          - const: nuclei,ux600fd

additionalProperties: true

...
```

## Documentation/devicetree/bindings/serial/sbi-console.yaml
```yaml
# SPDX-License-Identifier: (GPL-2.0-only OR BSD-2-Clause)
%YAML 1.2
---
$id: http://devicetree.org/schemas/serial/sbi-console.yaml#
$schema: http://devicetree.org/meta-schemas/core.yaml#

title: RISC-V SBI Console

maintainers:
  - support@nucleisys.com

description: |
  RISC-V SBI (Supervisor Binary Interface) console device for early
  console output via SBI calls.

properties:
  compatible:
    const: sbi,console

required:
  - compatible

additionalProperties: false

examples:
  - |
    console {
      compatible = "sbi,console";
    };

...
```

## Documentation/devicetree/bindings/watchdog/riscv,fsl-wdt.yaml
```yaml
# SPDX-License-Identifier: (GPL-2.0-only OR BSD-2-Clause)
%YAML 1.2
---
$id: http://devicetree.org/schemas/watchdog/riscv,fsl-wdt.yaml#
$schema: http://devicetree.org/meta-schemas/core.yaml#

title: RISC-V FSL Watchdog Timer

maintainers:
  - support@nucleisys.com

description: |
  Watchdog timer for Nuclei UX600 series SoCs. This watchdog
  timer is based on the Freescale watchdog controller design.

allOf:
  - $ref: watchdog.yaml#

properties:
  compatible:
    oneOf:
      - const: riscv,fsl-wdt
      - items:
          - enum:
              - nuclei,ux600-wdt
              - nuclei,ux600fd-wdt
          - const: riscv,fsl-wdt

  reg:
    maxItems: 1

  interrupts:
    maxItems: 1

  clocks:
    maxItems: 1

  clock-names:
    items:
      - const: hfclk

required:
  - compatible
  - reg
  - interrupts

unevaluatedProperties: false

examples:
  - |
    watchdog@68000000 {
        compatible = "nuclei,ux600fd-wdt", "riscv,fsl-wdt";
        reg = <0x0 0x68000000 0x0 0x20>;
        interrupt-parent = <&plic0>;
        interrupts = <8>;
        clocks = <&hfclk>;
        status = "okay";
    };

...
```

## drivers/misc/fisilink/Kconfig
```kconfig
# SPDX-License-Identifier: GPL-2.0-only
#
# Fisilink misc device configuration
#

config SWITCH_INTERFACE
	tristate "FiberHome switch register access support"
	depends on FISILINK
	help
	  This driver provides support for Xuanyuan1030M CPU to access
	  FiberHome switch registers through a misc device interface.

	  The driver provides register read/write operations, DMA buffer
	  management, and memory mapping support for userspace access.

	  To compile this driver as a module, choose M here: the module
	  will be called fh_pcie2pata.

	  If unsure, say Y.
```
